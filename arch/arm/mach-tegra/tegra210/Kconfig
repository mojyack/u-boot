## arch/arm/mach-tegra/tegra210/Kconfig
```kconfig
if TEGRA210

choice
	prompt "Tegra210 board select"

config TARGET_P2371_0000
	bool "NVIDIA Tegra210 P2371-0000 board"
	select BOARD_LATE_INIT
	help
	  P2371-0000 is a P2581 or P2530 CPU board married to a P2595 I/O
	  board. The combination contains SoC, DRAM, eMMC, SD card slot,
	  HDMI, USB micro-B port, Ethernet via USB3, USB3 host port, SATA,
	  a GPIO expansion header, and an analog audio jack.

config TARGET_P2371_2180
	bool "NVIDIA Tegra210 P2371-2180 (Jetson TX1) board"
	select BOARD_LATE_INIT
	help
	  P2371-2180 (Jetson TX1 developer kit) is a P2180 CPU board married
	  to a P2597 I/O board. The combination contains SoC, DRAM, eMMC, SD
	  card slot, HDMI, USB micro-B port, Ethernet via USB3, USB3 host
	  port, SATA, PCIe, and two GPIO expansion headers.

config TARGET_P2571
	bool "NVIDIA Tegra210 P2571 base board"
	select BOARD_LATE_INIT
	help
	  P2571 is a P2530 married to a P1963 I/O board

config TARGET_P3450_0000
	bool "NVIDIA Jetson Nano Developer Kit"
	select BOARD_LATE_INIT
	help
	  P3450-0000 is a P3448 CPU board married to a P3449 I/O board.

config TARGET_NINTENDO_SWITCH
	bool "Nintendo Switch"
	select BOARD_LATE_INIT
	help
	  The Nintendo Switch (HAC-001) is a Tegra210 handheld console. U-Boot
	  runs as BL33 under hekate's L4T loader, which has already brought up
	  DRAM and installed a BL31 at EL3.

endchoice

config SYS_SOC
	default "tegra210"

config TEGRA210_CARVEOUT_EXACT_SIZE
	bool "Derive the carve-out size from the memory controller"
	default n
	help
	  Instead of reserving a conservative fixed 512MB at the top of the
	  RAM below 4GiB, walk the memory controller's carve-out registers
	  (secure OS, CPU microcode, video protect and the five general
	  security carve-outs) and reserve only from the lowest programmed
	  carve-out upwards.

	  This is only correct when U-Boot itself programmed those carve-outs,
	  or ran secure alongside the software that did: the MC reports nothing
	  for a carve-out nobody programmed, and several of these registers are
	  TrustZone protected and read back all-ones from non-secure. Note also
	  that carve-outs U-Boot programs from board_init() land too late to be
	  seen here, as DRAM is sized in board_init_f.

	  Say N if earlier boot software owns the carve-outs and hands U-Boot a
	  memory layout that already excludes them - which is what the Tegra
	  cboot handoff path does.

source "board/nintendo/switch/Kconfig"
source "board/nvidia/p2371-0000/Kconfig"
source "board/nvidia/p2371-2180/Kconfig"
source "board/nvidia/p2571/Kconfig"
source "board/nvidia/p3450-0000/Kconfig"

endif
```

## board/nintendo/switch/Kconfig
```kconfig
if TARGET_NINTENDO_SWITCH

config SYS_BOARD
	default "switch"

config SYS_VENDOR
	default "nintendo"

config TEGRA_BOARD_STRING
	string "Default Tegra board name"
	default "Nintendo Switch"

endif
```

## configs/nintendo-switch_defconfig
```kconfig
CONFIG_ARM=y
CONFIG_SYS_HAS_NONCACHED_MEMORY=y
CONFIG_SYS_NONCACHED_MEMORY=0
CONFIG_COUNTER_FREQUENCY=19200000
CONFIG_SYS_L2CACHE_OFF=y
CONFIG_ARCH_TEGRA=y
CONFIG_TEXT_BASE=0xaa000000
CONFIG_SYS_MALLOC_LEN=0x2500000
CONFIG_ENV_SOURCE_FILE="nintendo-switch"
CONFIG_NR_DRAM_BANKS=2
CONFIG_ENV_SIZE=0x2000
CONFIG_DEFAULT_DEVICE_TREE="tegra210-nintendo-switch"
CONFIG_SYS_BOOTM_LEN=0x2000000
CONFIG_SYS_LOAD_ADDR=0x80080000
CONFIG_TEGRA210=y
CONFIG_TEGRA210_CARVEOUT_EXACT_SIZE=y
CONFIG_TARGET_NINTENDO_SWITCH=y
CONFIG_TEGRA_ENABLE_UARTB=y
CONFIG_POSITION_INDEPENDENT=y
CONFIG_OF_BOARD_SETUP=y
CONFIG_OF_SYSTEM_SETUP=y
CONFIG_SYS_PBSIZE=2089
CONFIG_SYS_PROMPT="Nintendo Switch # "
CONFIG_BOOTDELAY=1
# CONFIG_BOOTM_PLAN9 is not set
# CONFIG_BOOTM_RTEMS is not set
# CONFIG_BOOTM_VXWORKS is not set
# CONFIG_CMD_ELF is not set
# CONFIG_CMD_GO is not set
# CONFIG_CMD_IMI is not set
# CONFIG_CRC32_VERIFY is not set
CONFIG_CMD_GPIO=y
CONFIG_CMD_I2C=y
CONFIG_CMD_MMC=y
CONFIG_CMD_POWEROFF=y
CONFIG_CMD_SYSBOOT=y
# CONFIG_CMD_NET is not set
CONFIG_CMD_EXT4_WRITE=y
CONFIG_OF_LIVE=y
CONFIG_ENV_OVERWRITE=y
# CONFIG_ENV_IS_IN_MMC is not set
CONFIG_ENV_IS_NOWHERE=y
CONFIG_SYS_I2C_TEGRA=y
CONFIG_ARM_PSCI_FW=y
CONFIG_SYSRESET=y
CONFIG_SYSRESET_PSCI=y
# CONFIG_SYSRESET_TEGRA is not set
CONFIG_SYS_NS16550=y
```
